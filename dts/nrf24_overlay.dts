/dts-v1/;
/plugin/;

/ {
    compatible = "xunlong,orangepi-zero", "allwinner,sun8i-h2-plus";
    
    fragment@0 {
        target = <&spi1>;
        __overlay__ {
            status = "okay";

            spidev@0{
                status = "disabled";
            };
        };
    };
    
    fragment@1 {
        target = <&spi1>;
        __overlay__ {
            status = "okay";
            #address-cells = <1>;
            #size-cells = <0>;

            nrf24@0 {
                compatible = "nordic,nrf24";
                reg = <0>;
                spi-max-frequency = <800000>;
                status = "okay";

                interrupt-parent = <&pio>;
                interrupts = <0 18 0x2>;
                irq-gpio = <&pio 0 18 0>;
                ce-gpio = <&pio 0 6 2>;
            };
        };
    };
};